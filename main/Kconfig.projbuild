## main/Kconfig.projbuild
```kconfig
menu "Application Configuration"

	config ESP_WIFI_SSID
		string "WiFi SSID"
		default "myssid"
		help
			SSID (network name) for the example to connect to.

	config ESP_WIFI_PASSWORD
		string "WiFi Password"
		default "mypassword"
		help
			WiFi password (WPA or WPA2) for the example to use.

	config ESP_MAXIMUM_RETRY
		int "Maximum retry"
		default 5
		help
			Set the Maximum retry to avoid station reconnecting to the AP unlimited when the AP is really inexistent.

	config ESP_WEB_SERVER
		string "HTTP Server IP or mDNS"
		default "httpserver.local"
		help
			HTTP Server IP or mDNS.

	config ESP_WEB_SERVER_PORT
		int "HTTP server Port"
		default 8080
		help
			HTTP server port to use.

	config JSON_PRINT
		bool "Enable JSON Print to STDOUT"
		default y
		help
			Enable JSON Print to STDOUT.

endmenu
```
